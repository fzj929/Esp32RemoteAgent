## Code/ESP-IDF/Esp32RemoteAgent/main/Kconfig.projbuild
```kconfig
menu "Remote Agent Configuration"

config REMOTE_AGENT_WIFI_SSID
    string "WiFi SSID"
    default "YOUR_WIFI_SSID"

config REMOTE_AGENT_WIFI_PASSWORD
    string "WiFi Password"
    default "YOUR_WIFI_PASSWORD"

config REMOTE_AGENT_SERVER_HOST
    string "Relay server IPv4 address"
    default "YOUR_RELAY_SERVER_IP"

config REMOTE_AGENT_SERVER_CONTROL_PORT
    int "Relay server control port"
    range 1 65535
    default 6555

config REMOTE_AGENT_BOARD_ID
    string "Board ID"
    default "S3-0001"

config REMOTE_AGENT_BOARD_KEY
    string "Board authentication key"
    default "CHANGE_THIS_DEVICE_SECRET"

config REMOTE_AGENT_ASSIGNED_PUBLIC_PORT
    int "Legacy fallback public RDP port"
    range 6500 6600
    default 6500
    help
        Current firmware asks the relay server for the assigned public port during registration.
        This value is kept for old tooling and fallback documentation only.

config REMOTE_AGENT_TERMINAL_RDP_HOST
    string "Terminal RDP host"
    default "192.168.77.2"

config REMOTE_AGENT_TERMINAL_RDP_PORT
    int "Terminal RDP port"
    range 1 65535
    default 3389

config REMOTE_AGENT_MAX_TUNNELS
    int "Maximum concurrent TCP tunnels"
    range 4 32
    default 16
    help
        HTTP/HTTPS pages usually open several TCP connections at the same time
        for JavaScript, CSS, images, and API calls. Keep this high enough for
        web forwarding, but avoid excessive values because every tunnel consumes
        ESP32 socket buffers and heap.

config REMOTE_AGENT_TERMINAL_CONNECT_TIMEOUT_MS
    int "Terminal TCP connect timeout in milliseconds"
    range 300 5000
    default 2500
    help
        Timeout for each terminal-side TCP connection. HTTP forwarding creates
        many short connections, so a long blocking connect can make other
        tunnels feel slow. Keep this near 1500-2500 ms on a healthy USB link.

config REMOTE_AGENT_PENDING_TX_BUFFER
    int "Pending data buffer per connecting tunnel"
    range 1024 16384
    default 8192
    help
        Bytes of server-to-terminal data buffered while the terminal TCP
        connection is still being established.

config REMOTE_AGENT_STATUS_LED_ENABLED
    bool "Enable onboard RGB status LED"
    default y

config REMOTE_AGENT_STATUS_LED_GPIO
    int "Onboard RGB LED GPIO"
    depends on REMOTE_AGENT_STATUS_LED_ENABLED
    range 0 48
    default 48

config REMOTE_AGENT_STATUS_LED_BRIGHTNESS
    int "RGB status LED brightness"
    depends on REMOTE_AGENT_STATUS_LED_ENABLED
    range 1 255
    default 80

endmenu
```

## Code/ESP-IDF/Esp32RemoteAgent/sdkconfig.defaults
```kconfig
CONFIG_IDF_TARGET="esp32s3"
CONFIG_TINYUSB_TASK_AFFINITY_CPU0=y
CONFIG_TINYUSB_INIT_IN_DEFAULT_TASK=y
CONFIG_TINYUSB_NET_MODE_NCM=y
CONFIG_LWIP_DHCPS=y
CONFIG_ESP_WIFI_STA_DISCONNECTED_PM_ENABLE=n
CONFIG_REMOTE_AGENT_WIFI_SSID="YOUR_WIFI_SSID"
CONFIG_REMOTE_AGENT_WIFI_PASSWORD="YOUR_WIFI_PASSWORD"
CONFIG_REMOTE_AGENT_SERVER_HOST="YOUR_RELAY_SERVER_IP"
CONFIG_REMOTE_AGENT_SERVER_CONTROL_PORT=6555
CONFIG_REMOTE_AGENT_BOARD_ID="S3-0001"
CONFIG_REMOTE_AGENT_BOARD_KEY="CHANGE_THIS_DEVICE_SECRET"
CONFIG_REMOTE_AGENT_ASSIGNED_PUBLIC_PORT=6500
CONFIG_REMOTE_AGENT_TERMINAL_RDP_HOST="192.168.77.2"
CONFIG_REMOTE_AGENT_TERMINAL_RDP_PORT=3389
CONFIG_REMOTE_AGENT_MAX_TUNNELS=16
CONFIG_REMOTE_AGENT_TERMINAL_CONNECT_TIMEOUT_MS=2500
CONFIG_REMOTE_AGENT_PENDING_TX_BUFFER=8192
CONFIG_REMOTE_AGENT_STATUS_LED_ENABLED=y
CONFIG_REMOTE_AGENT_STATUS_LED_GPIO=48
CONFIG_REMOTE_AGENT_STATUS_LED_BRIGHTNESS=80
```
